## nrf52840/build/Kconfig/Kconfig.modules
```kconfig
menu "acpica (/Users/j/csse4011/prac3/modules/lib/acpica)"
osource "$(ZEPHYR_ACPICA_KCONFIG)"
config ZEPHYR_ACPICA_MODULE
	bool
	default y
endmenu
menu "cmsis (/Users/j/csse4011/prac3/modules/hal/cmsis)"
osource "$(ZEPHYR_CMSIS_KCONFIG)"
config ZEPHYR_CMSIS_MODULE
	bool
	default y
endmenu
menu "cmsis-dsp (/Users/j/csse4011/prac3/modules/lib/cmsis-dsp)"
osource "$(ZEPHYR_CMSIS_DSP_KCONFIG)"
config ZEPHYR_CMSIS_DSP_MODULE
	bool
	default y
endmenu
menu "cmsis-nn (/Users/j/csse4011/prac3/modules/lib/cmsis-nn)"
osource "$(ZEPHYR_CMSIS_NN_KCONFIG)"
config ZEPHYR_CMSIS_NN_MODULE
	bool
	default y
endmenu
menu "fatfs (/Users/j/csse4011/prac3/modules/fs/fatfs)"
osource "$(ZEPHYR_FATFS_KCONFIG)"
config ZEPHYR_FATFS_MODULE
	bool
	default y
endmenu
config ZEPHYR_ALTERA_MODULE
   bool
   default y
menu "hal_ambiq (/Users/j/csse4011/prac3/modules/hal/ambiq)"
osource "$(ZEPHYR_HAL_AMBIQ_KCONFIG)"
config ZEPHYR_HAL_AMBIQ_MODULE
	bool
	default y
endmenu
config ZEPHYR_ATMEL_MODULE
   bool
   default y
menu "hal_espressif (/Users/j/csse4011/prac3/modules/hal/espressif)"
osource "/Users/j/csse4011/prac3/modules/hal/espressif/zephyr/Kconfig"
config ZEPHYR_HAL_ESPRESSIF_MODULE
	bool
	default y
endmenu
menu "hal_ethos_u (/Users/j/csse4011/prac3/modules/hal/ethos_u)"
osource "$(ZEPHYR_HAL_ETHOS_U_KCONFIG)"
config ZEPHYR_HAL_ETHOS_U_MODULE
	bool
	default y
endmenu
menu "hal_gigadevice (/Users/j/csse4011/prac3/modules/hal/gigadevice)"
osource "$(ZEPHYR_HAL_GIGADEVICE_KCONFIG)"
config ZEPHYR_HAL_GIGADEVICE_MODULE
	bool
	default y
endmenu
menu "hal_infineon (/Users/j/csse4011/prac3/modules/hal/infineon)"
osource "$(ZEPHYR_HAL_INFINEON_KCONFIG)"
config ZEPHYR_HAL_INFINEON_MODULE
	bool
	default y
endmenu
config ZEPHYR_HAL_INTEL_MODULE
   bool
   default y
config ZEPHYR_MICROCHIP_MODULE
   bool
   default y
menu "hal_nordic (/Users/j/csse4011/prac3/modules/hal/nordic)"
osource "$(ZEPHYR_HAL_NORDIC_KCONFIG)"
config ZEPHYR_HAL_NORDIC_MODULE
	bool
	default y
endmenu
config ZEPHYR_NUVOTON_MODULE
   bool
   default y
menu "hal_nxp (/Users/j/csse4011/prac3/modules/hal/nxp)"
osource "$(ZEPHYR_HAL_NXP_KCONFIG)"
config ZEPHYR_HAL_NXP_MODULE
	bool
	default y
endmenu
config ZEPHYR_OPENISA_MODULE
   bool
   default y
config ZEPHYR_QUICKLOGIC_MODULE
   bool
   default y
config ZEPHYR_HAL_RENESAS_MODULE
   bool
   default y
menu "hal_rpi_pico (/Users/j/csse4011/prac3/modules/hal/rpi_pico)"
osource "$(ZEPHYR_HAL_RPI_PICO_KCONFIG)"
config ZEPHYR_HAL_RPI_PICO_MODULE
	bool
	default y
endmenu
menu "silabs (/Users/j/csse4011/prac3/modules/hal/silabs)"
osource "/Users/j/csse4011/prac3/modules/hal/silabs/zephyr/Kconfig"
config ZEPHYR_SILABS_MODULE
	bool
	default y
endmenu
menu "hal_st (/Users/j/csse4011/prac3/modules/hal/st)"
osource "$(ZEPHYR_HAL_ST_KCONFIG)"
config ZEPHYR_HAL_ST_MODULE
	bool
	default y
endmenu
config ZEPHYR_STM32_MODULE
   bool
   default y
menu "hal_telink (/Users/j/csse4011/prac3/modules/hal/telink)"
osource "/Users/j/csse4011/prac3/modules/hal/telink/Kconfig"
config ZEPHYR_HAL_TELINK_MODULE
	bool
	default y
endmenu
config ZEPHYR_TI_MODULE
   bool
   default y
config ZEPHYR_HAL_WURTHELEKTRONIK_MODULE
   bool
   default y
config ZEPHYR_XTENSA_MODULE
   bool
   default y
menu "hostap (/Users/j/csse4011/prac3/modules/lib/hostap)"
osource "$(ZEPHYR_HOSTAP_KCONFIG)"
config ZEPHYR_HOSTAP_MODULE
	bool
	default y
endmenu
config ZEPHYR_LIBMETAL_MODULE
   bool
   default y
menu "liblc3 (/Users/j/csse4011/prac3/modules/lib/liblc3)"
osource "$(ZEPHYR_LIBLC3_KCONFIG)"
config ZEPHYR_LIBLC3_MODULE
	bool
	default y
endmenu
menu "littlefs (/Users/j/csse4011/prac3/modules/fs/littlefs)"
osource "$(ZEPHYR_LITTLEFS_KCONFIG)"
config ZEPHYR_LITTLEFS_MODULE
	bool
	default y
endmenu
menu "loramac-node (/Users/j/csse4011/prac3/modules/lib/loramac-node)"
osource "$(ZEPHYR_LORAMAC_NODE_KCONFIG)"
config ZEPHYR_LORAMAC_NODE_MODULE
	bool
	default y
endmenu
menu "lvgl (/Users/j/csse4011/prac3/modules/lib/gui/lvgl)"
osource "/Users/j/csse4011/prac3/modules/lib/gui/lvgl/Kconfig"
config ZEPHYR_LVGL_MODULE
	bool
	default y
endmenu
menu "mbedtls (/Users/j/csse4011/prac3/modules/crypto/mbedtls)"
osource "$(ZEPHYR_MBEDTLS_KCONFIG)"
config ZEPHYR_MBEDTLS_MODULE
	bool
	default y
endmenu
config ZEPHYR_MCUBOOT_MODULE
   bool
   default y
config ZEPHYR_MIPI_SYS_T_MODULE
   bool
   default y
config ZEPHYR_NRF_HW_MODELS_MODULE
   bool
   default y
config ZEPHYR_OPEN_AMP_MODULE
   bool
   default y
menu "openthread (/Users/j/csse4011/prac3/modules/lib/openthread)"
osource "$(ZEPHYR_OPENTHREAD_KCONFIG)"
config ZEPHYR_OPENTHREAD_MODULE
	bool
	default y
endmenu
menu "percepio (/Users/j/csse4011/prac3/modules/debug/percepio)"
osource "/Users/j/csse4011/prac3/modules/debug/percepio/zephyr/Kconfig"
config ZEPHYR_PERCEPIO_MODULE
	bool
	default y
endmenu
menu "picolibc (/Users/j/csse4011/prac3/modules/lib/picolibc)"
osource "/Users/j/csse4011/prac3/modules/lib/picolibc/zephyr/Kconfig"
config ZEPHYR_PICOLIBC_MODULE
	bool
	default y
endmenu
menu "segger (/Users/j/csse4011/prac3/modules/debug/segger)"
osource "$(ZEPHYR_SEGGER_KCONFIG)"
config ZEPHYR_SEGGER_MODULE
	bool
	default y
endmenu
config ZEPHYR_TINYCRYPT_MODULE
   bool
   default y
menu "trusted-firmware-m (/Users/j/csse4011/prac3/modules/tee/tf-m/trusted-firmware-m)"
osource "$(ZEPHYR_TRUSTED_FIRMWARE_M_KCONFIG)"
config ZEPHYR_TRUSTED_FIRMWARE_M_MODULE
	bool
	default y
endmenu
menu "trusted-firmware-a (/Users/j/csse4011/prac3/modules/tee/tf-a/trusted-firmware-a)"
osource "$(ZEPHYR_TRUSTED_FIRMWARE_A_KCONFIG)"
config ZEPHYR_TRUSTED_FIRMWARE_A_MODULE
	bool
	default y
endmenu
menu "uoscore-uedhoc (/Users/j/csse4011/prac3/modules/lib/uoscore-uedhoc)"
osource "$(ZEPHYR_UOSCORE_UEDHOC_KCONFIG)"
config ZEPHYR_UOSCORE_UEDHOC_MODULE
	bool
	default y
endmenu
menu "zcbor (/Users/j/csse4011/prac3/modules/lib/zcbor)"
osource "$(ZEPHYR_ZCBOR_KCONFIG)"
config ZEPHYR_ZCBOR_MODULE
	bool
	default y
endmenu
```

## nrf52840/build/Kconfig/arch/Kconfig
```kconfig
# Load arch Kconfig descriptions.
osource "/Users/j/csse4011/prac3/zephyr/arch/x86/Kconfig"
osource "/Users/j/csse4011/prac3/zephyr/arch/xtensa/Kconfig"
osource "/Users/j/csse4011/prac3/zephyr/arch/sparc/Kconfig"
osource "/Users/j/csse4011/prac3/zephyr/arch/riscv/Kconfig"
osource "/Users/j/csse4011/prac3/zephyr/arch/posix/Kconfig"
osource "/Users/j/csse4011/prac3/zephyr/arch/nios2/Kconfig"
osource "/Users/j/csse4011/prac3/zephyr/arch/mips/Kconfig"
osource "/Users/j/csse4011/prac3/zephyr/arch/arm64/Kconfig"
osource "/Users/j/csse4011/prac3/zephyr/arch/arm/Kconfig"
osource "/Users/j/csse4011/prac3/zephyr/arch/arc/Kconfig"
```

## nrf52840/build/Kconfig/soc/Kconfig
```kconfig
# Load Zephyr SoC Kconfig descriptions.
osource "/Users/j/csse4011/prac3/zephyr/soc/xlnx/zynqmp/Kconfig"
osource "/Users/j/csse4011/prac3/zephyr/soc/xlnx/zynq7000/Kconfig"
osource "/Users/j/csse4011/prac3/zephyr/soc/xen/Kconfig"
osource "/Users/j/csse4011/prac3/zephyr/soc/ti/simplelink/Kconfig"
osource "/Users/j/csse4011/prac3/zephyr/soc/ti/lm3s6965/Kconfig"
osource "/Users/j/csse4011/prac3/zephyr/soc/ti/k3/Kconfig"
osource "/Users/j/csse4011/prac3/zephyr/soc/telink/tlsr/Kconfig"
osource "/Users/j/csse4011/prac3/zephyr/soc/starfive/jh71xx/Kconfig"
osource "/Users/j/csse4011/prac3/zephyr/soc/st/stm32/Kconfig"
osource "/Users/j/csse4011/prac3/zephyr/soc/snps/qemu_arc/Kconfig"
osource "/Users/j/csse4011/prac3/zephyr/soc/snps/nsim/Kconfig"
osource "/Users/j/csse4011/prac3/zephyr/soc/snps/hsdk4xd/Kconfig"
osource "/Users/j/csse4011/prac3/zephyr/soc/snps/hsdk/Kconfig"
osource "/Users/j/csse4011/prac3/zephyr/soc/snps/emsk/Kconfig"
osource "/Users/j/csse4011/prac3/zephyr/soc/snps/emsdp/Kconfig"
osource "/Users/j/csse4011/prac3/zephyr/soc/snps/arc_iot/Kconfig"
osource "/Users/j/csse4011/prac3/zephyr/soc/silabs/Kconfig"
osource "/Users/j/csse4011/prac3/zephyr/soc/sifive/sifive_freedom/Kconfig"
osource "/Users/j/csse4011/prac3/zephyr/soc/rockchip/Kconfig"
osource "/Users/j/csse4011/prac3/zephyr/soc/renode/riscv_virtual/Kconfig"
osource "/Users/j/csse4011/prac3/zephyr/soc/renesas/smartbond/Kconfig"
osource "/Users/j/csse4011/prac3/zephyr/soc/renesas/rzt2m/Kconfig"
osource "/Users/j/csse4011/prac3/zephyr/soc/renesas/rcar/Kconfig"
osource "/Users/j/csse4011/prac3/zephyr/soc/renesas/ra/Kconfig"
osource "/Users/j/csse4011/prac3/zephyr/soc/raspberrypi/Kconfig"
osource "/Users/j/csse4011/prac3/zephyr/soc/quicklogic/eos_s3/Kconfig"
osource "/Users/j/csse4011/prac3/zephyr/soc/qemu/virt_riscv/Kconfig"
osource "/Users/j/csse4011/prac3/zephyr/soc/qemu/malta/Kconfig"
osource "/Users/j/csse4011/prac3/zephyr/soc/openisa/rv32m1/Kconfig"
osource "/Users/j/csse4011/prac3/zephyr/soc/nxp/s32/Kconfig"
osource "/Users/j/csse4011/prac3/zephyr/soc/nxp/rw/Kconfig"
osource "/Users/j/csse4011/prac3/zephyr/soc/nxp/mcx/Kconfig"
osource "/Users/j/csse4011/prac3/zephyr/soc/nxp/lpc/Kconfig"
osource "/Users/j/csse4011/prac3/zephyr/soc/nxp/layerscape/Kconfig"
osource "/Users/j/csse4011/prac3/zephyr/soc/nxp/kinetis/Kconfig"
osource "/Users/j/csse4011/prac3/zephyr/soc/nxp/imxrt/Kconfig"
osource "/Users/j/csse4011/prac3/zephyr/soc/nxp/imx/Kconfig"
osource "/Users/j/csse4011/prac3/zephyr/soc/nuvoton/numicro/Kconfig"
osource "/Users/j/csse4011/prac3/zephyr/soc/nuvoton/numaker/Kconfig"
osource "/Users/j/csse4011/prac3/zephyr/soc/nuvoton/npcx/Kconfig"
osource "/Users/j/csse4011/prac3/zephyr/soc/nordic/Kconfig"
osource "/Users/j/csse4011/prac3/zephyr/soc/neorv32/Kconfig"
osource "/Users/j/csse4011/prac3/zephyr/soc/native/inf_clock/Kconfig"
osource "/Users/j/csse4011/prac3/zephyr/soc/microchip/miv/Kconfig"
osource "/Users/j/csse4011/prac3/zephyr/soc/microchip/mec/Kconfig"
osource "/Users/j/csse4011/prac3/zephyr/soc/lowrisc/opentitan/Kconfig"
osource "/Users/j/csse4011/prac3/zephyr/soc/litex/litex_vexriscv/Kconfig"
osource "/Users/j/csse4011/prac3/zephyr/soc/ite/ec/Kconfig"
osource "/Users/j/csse4011/prac3/zephyr/soc/intel/raptor_lake/Kconfig"
osource "/Users/j/csse4011/prac3/zephyr/soc/intel/lakemont/Kconfig"
osource "/Users/j/csse4011/prac3/zephyr/soc/intel/intel_socfpga_std/Kconfig"
osource "/Users/j/csse4011/prac3/zephyr/soc/intel/intel_socfpga/Kconfig"
osource "/Users/j/csse4011/prac3/zephyr/soc/intel/intel_niosv/Kconfig"
osource "/Users/j/csse4011/prac3/zephyr/soc/intel/intel_ish/Kconfig"
osource "/Users/j/csse4011/prac3/zephyr/soc/intel/intel_adsp/Kconfig"
osource "/Users/j/csse4011/prac3/zephyr/soc/intel/elkhart_lake/Kconfig"
osource "/Users/j/csse4011/prac3/zephyr/soc/intel/atom/Kconfig"
osource "/Users/j/csse4011/prac3/zephyr/soc/intel/apollo_lake/Kconfig"
osource "/Users/j/csse4011/prac3/zephyr/soc/intel/alder_lake/Kconfig"
osource "/Users/j/csse4011/prac3/zephyr/soc/infineon/xmc/Kconfig"
osource "/Users/j/csse4011/prac3/zephyr/soc/gd/gd32/Kconfig"
osource "/Users/j/csse4011/prac3/zephyr/soc/gaisler/leon3/Kconfig"
osource "/Users/j/csse4011/prac3/zephyr/soc/gaisler/gr716a/Kconfig"
osource "/Users/j/csse4011/prac3/zephyr/soc/espressif/Kconfig"
osource "/Users/j/csse4011/prac3/zephyr/soc/ene/kb1200/Kconfig"
osource "/Users/j/csse4011/prac3/zephyr/soc/efinix/sapphire/Kconfig"
osource "/Users/j/csse4011/prac3/zephyr/soc/cypress/Kconfig"
osource "/Users/j/csse4011/prac3/zephyr/soc/cdns/xtensa_sample_controller/Kconfig"
osource "/Users/j/csse4011/prac3/zephyr/soc/cdns/dc233c/Kconfig"
osource "/Users/j/csse4011/prac3/zephyr/soc/brcm/bcmvk/Kconfig"
osource "/Users/j/csse4011/prac3/zephyr/soc/brcm/bcm2711/Kconfig"
osource "/Users/j/csse4011/prac3/zephyr/soc/atmel/sam0/Kconfig"
osource "/Users/j/csse4011/prac3/zephyr/soc/atmel/sam/Kconfig"
osource "/Users/j/csse4011/prac3/zephyr/soc/aspeed/Kconfig"
osource "/Users/j/csse4011/prac3/zephyr/soc/arm/Kconfig"
osource "/Users/j/csse4011/prac3/zephyr/soc/arm/beetle/Kconfig"
osource "/Users/j/csse4011/prac3/zephyr/soc/andestech/Kconfig"
osource "/Users/j/csse4011/prac3/zephyr/soc/ambiq/Kconfig"
osource "/Users/j/csse4011/prac3/zephyr/soc/altr/zephyr_nios2f/Kconfig"
osource "/Users/j/csse4011/prac3/zephyr/soc/altr/qemu_nios2/Kconfig"
```
