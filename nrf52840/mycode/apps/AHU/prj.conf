## CMakeLists.txt
```
# SPDX-License-Identifier: Apache-2.0

cmake_minimum_required(VERSION 3.20.0)
find_package(Zephyr REQUIRED HINTS $ENV{ZEPHYR_BASE})
project(ahu)

include_directories(../../include)
target_sources(app PRIVATE src/main.c ../../mylib/uart_rec.c ../../mylib/bt_ahu.c)
```

## prj.conf
```kconfig
CONFIG_SERIAL=y
CONFIG_UART_INTERRUPT_DRIVEN=y
CONFIG_JSON_LIBRARY=y

CONFIG_LOG=y
CONFIG_BT=y
CONFIG_BT_DEVICE_NAME="Vessel Advertising"
```

## nrf52840dk_nrf52840.overlay
```dts
&uart1 {
	current-speed = <115200>;
    status = "okay";
	pinctrl-0 = <&uart1_default>;
	pinctrl-1 = <&uart1_sleep>;
	pinctrl-names = "default", "sleep";
};
```

## src/main.c
```c
#include <bt_ahu.h>
#include <stdlib.h>
#include <string.h>
#include <uart_rec.h>
#include <zephyr/bluetooth/bluetooth.h>
#include <zephyr/bluetooth/hci.h>
#include <zephyr/data/json.h>
#include <zephyr/device.h>
#include <zephyr/kernel.h>
#include <zephyr/logging/log.h>
#include <zephyr/shell/shell.h>
#include <zephyr/sys/printk.h>
#include <zephyr/sys/slist.h>
#include <zephyr/sys/util.h>
#include <zephyr/sys_clock.h>
#include <zephyr/types.h>
#include <zephyr/usb/usb_device.h>

#define PRIORITY 7
#define STACKSIZE 2048
#define ALL_MODULES 4
LOG_MODULE_REGISTER(AHU, 4);

// begin uart thread
K_THREAD_DEFINE(uart_task_id, STACKSIZE, uart_task, NULL, NULL, NULL, PRIORITY,
                0, 0);
// begin bt thread
K_THREAD_DEFINE(bt_task_id, STACKSIZE, bt_task, NULL, NULL, NULL, PRIORITY, 0,
                0);

K_THREAD_DEFINE(alter_data_task_id, STACKSIZE, alter_data_task, NULL, NULL,
                NULL, PRIORITY, 0, 0);
```
